/*
 * font.c
 *
 * Created: 02.04.2013 15:15:35
 *  Author: itchy
 */ 
#include <avr/eeprom.h>
#include <avr/interrupt.h>
#include "font.h"
#include "main.h"
#include "cube.h"


volatile const unsigned char font[455] EEMEM = {
	0x00,0x00,0x00,0x00,0x00,0x00,0x5f,0x5f,0x00,0x00,	//  !
	0x00,0x03,0x00,0x03,0x00,0x14,0x7f,0x14,0x7f,0x14,	// "#
	0x24,0x2a,0x7f,0x2a,0x12,0x23,0x13,0x08,0x64,0x62,	// $%
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	0x44,0x64,0x54,0x4c,0x44                            // z
};

volatile const unsigned char font_extra[8] EEMEM =
{
	0x78,0x84,0x84,0x86,0,87,0x87,0xB4,0x48	
};

void font_get_char (char chr, uint8_t tmp[5])
{
	chr -= 32;
	
	for (int8_t i = 0; i < 5; i++)
	{
		tmp[i] = (uint8_t)eeprom_read_byte((uint8_t*)&font[(chr*5)+i]);
	}
}

void font_get_extra( uint8_t number, uint8_t tmp[5] )
{
	for (int8_t i=0; i < 5; i++)
	{
		tmp[i] = (uint8_t)eeprom_read_byte((uint8_t*)&font_extra[(number*5)+i]);
	}	
}


void font_shift()
{
	//shift the String on the Y Axis, Step by Step from X-7
	for (int8_t y = 0; y < 7; y++ )
	{
		for (int8_t z = 0; z < CUBE_MAX; z++)
		{
			if (cube_get_led_status(7,y+1,z))
			{
				cube_set_led (7,y,z);
			}
			else
			{
				cube_clr_led (7,y,z);
			}
		}
	}
	//shift the String on the X+ Axis Step by Step from Y-7
	for (int8_t x = 7; x >= CUBE_MIN; x--)
	{
		for (int8_t z = 0; z < CUBE_MAX; z++)
		{
			if(cube_get_led_status(x-1,7,z))
			{
				cube_set_led(x,7,z);
			}
			else
			{
				cube_clr_led(x,7,z);		
			}
		}
	}		
	// shift the String on the Y-Axis step by step from X-0
	for (int8_t y = 7; y > CUBE_MIN; y-- )
	{
		for (int8_t z = 0; z < CUBE_MAX; z++)
		{
			if (cube_get_led_status(0,y-1,z))
			{
				cube_set_led (0,y,z);
			}
			else
			{
				cube_clr_led (0,y,z);
			}
		}
	}
}

